VERSION ""

NS_ :

BS_:

BU_: ZCU_F IVI

BO_ 2147485184 MCU_SWC_Status: 12 IVI
 SG_ uint32_0 : 64|32@1+ (1,0) [0|4294967295] "" Vector__XXX
 SG_ uint16_1 : 48|16@1+ (1,0) [0|65535] "" Vector__XXX
 SG_ uint16_0 : 32|16@1+ (1,0) [0|65535] "" Vector__XXX
 SG_ uint8_3 : 24|8@1+ (1,0) [0|255] ""  ZCU_F
 SG_ uint8_2 : 16|8@1+ (1,0) [0|255] ""  ZCU_F
 SG_ uint8_1 : 8|8@1+ (1,0) [0|255] ""  ZCU_F
 SG_ uint8_0 : 0|8@1+ (1,0) [0|255] ""  ZCU_F

BA_DEF_ SG_  "GenSigSendType" ENUM  "Cyclic","OnWrite","OnWriteWithRepetition","OnChange","OnChangeWithRepetition","IfActive","IfActiveWithRepetition","NoSigSendType","NotUsed","NotUsed","NotUsed","NotUsed","NotUsed";
BA_DEF_ BO_  "VFrameFormat" ENUM  "StandardCAN","ExtendedCAN","reserved","reserved","reserved","reserved","reserved","reserved","reserved","reserved","reserved","reserved","reserved","reserved","StandardCAN_FD","ExtendedCAN_FD";
BA_DEF_ BO_  "CANFD_BRS" ENUM  "0","1";
BA_DEF_ BO_  "GenMsgILSupport" ENUM  "No","Yes";
BA_DEF_ BO_  "GenMsgCycleTimeFast" INT 0 50000;
BA_DEF_ BO_  "GenMsgCycleTime" INT 0 50000;
BA_DEF_ BO_  "GenMsgSendType" ENUM  "Cyclic","NotUsed","NotUsed","NotUsed","NotUsed","Cyclic","NotUsed","IfActive","NoMsgSendType","NotUsed","vector_leerstring";
BA_DEF_ BU_  "NmStationAddress" INT 0 63;
BA_DEF_  "DBName" STRING ;
BA_DEF_  "NmBaseAddress" HEX 1024 1087;
BA_DEF_DEF_  "GenSigSendType" "Cyclic";
BA_DEF_DEF_  "VFrameFormat" "StandardCAN";
BA_DEF_DEF_  "CANFD_BRS" "1";
BA_DEF_DEF_  "GenMsgILSupport" "Yes";
BA_DEF_DEF_  "GenMsgCycleTimeFast" 0;
BA_DEF_DEF_  "GenMsgCycleTime" 0;
BA_DEF_DEF_  "GenMsgSendType" "NoMsgSendType";
BA_DEF_DEF_  "NmStationAddress" 0;
BA_DEF_DEF_  "DBName" "";
BA_DEF_DEF_  "NmBaseAddress" 1024;
BA_ "DBName" "I3_CAN_FD_Test";
BA_ "NmStationAddress" BU_ ZCU_F 5;
BA_ "NmStationAddress" BU_ IVI 2;
BA_ "GenMsgCycleTimeFast" BO_ 2147485184 100;
BA_ "GenMsgCycleTime" BO_ 2147485184 500;
BA_ "GenMsgSendType" BO_ 2147485184 0;
BA_ "VFrameFormat" BO_ 2147485184 15;
